## buzzer-test/main/Kconfig.projbuild
```kconfig
menu "Buzzer Configuration"

    config BUZZER_GPIO_PIN
        int "Buzzer GPIO Pin"
        default 21
        help
            GPIO pin number connected to the buzzer.

    config BUZZER_FREQUENCY
        int "Buzzer Frequency (Hz)"
        default 1046
        range 20 40000
        help
            Frequency of the PWM signal in Hertz.

    config BUZZER_DUTY_CYCLE
        int "Buzzer Duty Cycle (%)"
        default 50
        range 0 100
        help
            Duty cycle percentage (0-100).

endmenu
```

## wifi-helper/components/wifi_helper/Kconfig
```kconfig
menu "WiFi Helper Configuration"

    config WIFI_HELPER_SSID
        string "WiFi SSID"
        default "myssid"
        help
            SSID (network name) for the WiFi network to connect to.

    config WIFI_HELPER_PASSWORD
        string "WiFi Password"
        default "mypassword"
        help
            WiFi password (WPA or WPA2) for the network.

endmenu
```

## wifi-helper/main/Kconfig
```kconfig
menu "App Configuration"

    config APP_NAME
        string "Application Name"
        default "wifi-helper"
        help
            The name/tag used for logging in the application.

endmenu
```

## wifi_helper/main/Kconfig
```kconfig
menu "App Configuration"

    config APP_NAME
        string "Application Name"
        default "weather-app"
        help
            The name/tag used for logging in the application.

endmenu
```
